## OfflineVersion2/final_firmware/sdkconfig.defaults
```kconfig
# Flash Size and Partitioning
CONFIG_ESPTOOLPY_FLASHSIZE_4MB=y
CONFIG_PARTITION_TABLE_CUSTOM=y
CONFIG_PARTITION_TABLE_CUSTOM_FILENAME="partitions.csv"
CONFIG_PARTITION_TABLE_FILENAME="partitions.csv"
CONFIG_PARTITION_TABLE_OFFSET=0x8000

# Allow FreeRTOS Watchdog 60s for Heavy Math and Flash Writes
CONFIG_ESP_TASK_WDT_TIMEOUT_S=60

# Enable External PSRAM (Required for Camera & AI Tensors)
CONFIG_SPIRAM=y
CONFIG_SPIRAM_BOOT_INIT=y
CONFIG_SPIRAM_USE_MALLOC=y

# Increase default WebSocket buffer sizes for Base64 Images
CONFIG_WS_BUFFER_SIZE=16384

# --- IRAM MEMORY OPTIMIZATIONS FOR PREVENTING IRAM OVERFLOW ---
# Move Wi-Fi driver functions out of IRAM to save space
CONFIG_ESP_WIFI_IRAM_OPT=n
CONFIG_ESP_WIFI_RX_IRAM_OPT=n

# Move FreeRTOS and RingBuffer functions into Flash memory
CONFIG_FREERTOS_PLACE_FUNCTIONS_INTO_FLASH=y
CONFIG_RINGBUF_PLACE_FUNCTIONS_INTO_FLASH=y
```

## OfflineVersion2/tests/01_camera_ai_poc/sdkconfig.defaults
```kconfig
# 1. Flash & PSRAM Configuration
CONFIG_ESPTOOLPY_FLASHSIZE_4MB=y
CONFIG_SPIRAM=y
CONFIG_SPIRAM_USE_MALLOC=y
CONFIG_SPIRAM_SPEED_40M=y

# 2. Partitions (Models are large, we need app space)
CONFIG_PARTITION_TABLE_CUSTOM=y
CONFIG_PARTITION_TABLE_CUSTOM_FILENAME="partitions.csv"
CONFIG_PARTITION_TABLE_FILENAME="partitions.csv"
CONFIG_PARTITION_TABLE_OFFSET=0x8000

# 3. Memory / Task Stack (AI needs massive headroom)
CONFIG_ESP_MAIN_TASK_STACK_SIZE=32768
CONFIG_FREERTOS_HZ=1000

# 4. Enable C++ Exceptions (Required by esp-dl)
CONFIG_COMPILER_CXX_EXCEPTIONS=y

# Extend the FreeRTOS Watchdog timeout to allow for heavy MobileFaceNet inference
CONFIG_ESP_TASK_WDT_TIMEOUT_S=25
```

## OfflineVersion2/tests/02_camera_ai_nvs/sdkconfig.defaults
```kconfig
# Flash Size and Partitioning
CONFIG_ESPTOOLPY_FLASHSIZE_4MB=y
CONFIG_PARTITION_TABLE_CUSTOM=y
CONFIG_PARTITION_TABLE_CUSTOM_FILENAME="partitions.csv"
CONFIG_PARTITION_TABLE_FILENAME="partitions.csv"
CONFIG_PARTITION_TABLE_OFFSET=0x8000

# Allow FreeRTOS Watchdog 25s for Heavy Math
CONFIG_ESP_TASK_WDT_TIMEOUT_S=60

# ── CRITICAL: ENABLE EXTERNAL PSRAM ──
CONFIG_SPIRAM=y
CONFIG_SPIRAM_BOOT_INIT=y
CONFIG_SPIRAM_USE_MALLOC=y
```

## OfflineVersion3/final_firmware/05_ml_server_brain_v3/sdkconfig.defaults
```kconfig
CONFIG_ESPTOOLPY_FLASHSIZE_16MB=y
CONFIG_ESP32S3_SPIRAM_SUPPORT=y
CONFIG_SPIRAM_MODE_OCT=y
CONFIG_SPIRAM_SPEED_80M=y
CONFIG_SPIRAM_FETCH_INSTRUCTIONS=y
CONFIG_SPIRAM_RODATA=y
CONFIG_ESP32S3_DATA_CACHE_64KB=y
CONFIG_ESP32S3_INSTRUCTION_CACHE_32KB=y
CONFIG_ESP_DEFAULT_CPU_FREQ_MHZ_240=y
CONFIG_ESP_DEFAULT_CPU_FREQ_MHZ=240

# --- NEW REQUIRED SETTINGS ---
CONFIG_ESP32S3_DATA_CACHE_LINE_64B=y
CONFIG_COMPILER_OPTIMIZATION_PERF=y
CONFIG_HTTPD_WS_SUPPORT=y
CONFIG_PARTITION_TABLE_CUSTOM=y
CONFIG_PARTITION_TABLE_CUSTOM_FILENAME="partitions.csv"
CONFIG_HTTPD_MAX_REQ_HDR_LEN=2048

# LVGL Config
CONFIG_LV_COLOR_DEPTH_16=y
CONFIG_LV_MEM_CUSTOM=y
CONFIG_LV_USE_USER_DATA=y

CONFIG_FREERTOS_HZ=1000
```

## OfflineVersion3/tests/01_lvgl_display_testing/sdkconfig.defaults
```kconfig
# --- Flash & Memory ---
CONFIG_ESPTOOLPY_FLASHSIZE_16MB=y
CONFIG_PARTITION_TABLE_CUSTOM=y
CONFIG_PARTITION_TABLE_CUSTOM_FILENAME="partitions.csv"

# --- PSRAM Configuration (Octal for N16R8) ---
CONFIG_SPIRAM=y
CONFIG_SPIRAM_MODE_OCT=y
CONFIG_SPIRAM_SPEED_80M=y
CONFIG_SPIRAM_USE_MALLOC=y

# --- RTOS & System Stability ---
CONFIG_ESP_TASK_WDT_TIMEOUT_S=60
CONFIG_FREERTOS_PLACE_FUNCTIONS_INTO_FLASH=y
CONFIG_ESP_WIFI_IRAM_OPT=n

# --- Compiler Optimization for esp-dl ---
CONFIG_COMPILER_OPTIMIZATION_PERF=y
CONFIG_FREERTOS_HZ=1000
```

## OfflineVersion3/tests/02_ml_server_brain/sdkconfig.defaults
```kconfig
CONFIG_ESPTOOLPY_FLASHSIZE_16MB=y
CONFIG_ESP32S3_SPIRAM_SUPPORT=y
CONFIG_SPIRAM_MODE_OCT=y
CONFIG_SPIRAM_SPEED_80M=y
CONFIG_SPIRAM_FETCH_INSTRUCTIONS=y
CONFIG_SPIRAM_RODATA=y
CONFIG_ESP32S3_DATA_CACHE_64KB=y
CONFIG_ESP32S3_INSTRUCTION_CACHE_32KB=y
CONFIG_ESP_DEFAULT_CPU_FREQ_MHZ_240=y
CONFIG_ESP_DEFAULT_CPU_FREQ_MHZ=240

CONFIG_HTTPD_WS_SUPPORT=y
CONFIG_PARTITION_TABLE_CUSTOM=y
CONFIG_PARTITION_TABLE_CUSTOM_FILENAME="partitions.csv"
CONFIG_HTTPD_MAX_REQ_HDR_LEN=2048

# FreeRTOS config for ML operations
CONFIG_FREERTOS_HZ=1000
```

## OfflineVersion3/tests/05_cam_client_v2/sdkconfig.defaults
```kconfig
CONFIG_ESPTOOLPY_FLASHSIZE_4MB=y
CONFIG_ESP32_SPIRAM_SUPPORT=y
CONFIG_SPIRAM_USE_MALLOC=y
CONFIG_SPIRAM_SPEED_40M=y

# FreeRTOS and Watchdog tuning to prevent camera timeout resets
CONFIG_FREERTOS_HZ=1000
CONFIG_ESP_TASK_WDT_TIMEOUT_S=10

# Increase networking buffer to handle WebSocket JPEGs
CONFIG_TCP_WND_DEFAULT=16384

# Partition Table
CONFIG_PARTITION_TABLE_CUSTOM=y
CONFIG_PARTITION_TABLE_CUSTOM_FILENAME="partitions.csv"
```

## OfflineVersion3/tests/06_raw_display_test_FAIL/sdkconfig.defaults
```kconfig
CONFIG_ESP32S3_SPIRAM_SUPPORT=y
CONFIG_SPIRAM_MODE_OCT=y
CONFIG_SPIRAM_SPEED_80M=y
CONFIG_SPIRAM_USE_MALLOC=y
CONFIG_ESPTOOLPY_FLASHSIZE_16MB=y
```

## OfflineVersion3/tests/08_lvgl_image_touch_test_WORKING/sdkconfig.defaults
```kconfig
CONFIG_ESPTOOLPY_FLASHSIZE_16MB=y
CONFIG_ESP32S3_SPIRAM_SUPPORT=y
CONFIG_SPIRAM_MODE_OCT=y
CONFIG_SPIRAM_SPEED_80M=y
CONFIG_SPIRAM_USE_MALLOC=y
CONFIG_FREERTOS_HZ=1000

# LVGL Configuration Overrides (Bypasses the need for lv_conf.h)
CONFIG_LV_COLOR_DEPTH_16=y
CONFIG_LV_MEM_CUSTOM=y
CONFIG_LV_USE_USER_DATA=y
CONFIG_HTTPD_WS_SUPPORT=y

CONFIG_PARTITION_TABLE_CUSTOM=y
CONFIG_PARTITION_TABLE_CUSTOM_FILENAME="partitions.csv"

CONFIG_ESP32S3_DATA_CACHE_LINE_64B=y
CONFIG_COMPILER_OPTIMIZATION_PERF=y
```

## Version2_2/camera_idf/sdkconfig.defaults
```kconfig
# 1. Flash Memory Configuration (Standard ESP32-CAM has 4MB)
CONFIG_ESPTOOLPY_FLASHSIZE_4MB=y
CONFIG_ESPTOOLPY_FLASHSIZE="4MB"

# 2. Enable External PSRAM (CRITICAL for ESP32-CAM / CAMERA_FB_IN_PSRAM)
CONFIG_SPIRAM=y
CONFIG_SPIRAM_USE_MALLOC=y
CONFIG_SPIRAM_SPEED_40M=y

# 3. Partition Table (Expand App size to fit Camera + WebSocket drivers)
CONFIG_PARTITION_TABLE_SINGLE_APP_LARGE=y
CONFIG_PARTITION_TABLE_CUSTOM=n

# 4. Memory / Task Stack (Camera and WebSockets require more headroom)
CONFIG_ESP_MAIN_TASK_STACK_SIZE=8192

# 5. Enable HTTP Client & WebSockets
CONFIG_ESP_HTTP_CLIENT_ENABLE=y

# 6. Set FreeRTOS Tick Rate to 1000Hz (Better for 10FPS WebSocket streaming)
CONFIG_FREERTOS_HZ=1000
```

## Version2_2/display_idf/sdkconfig.defaults
```kconfig
# Flash
CONFIG_ESPTOOLPY_FLASHSIZE_16MB=y
CONFIG_ESPTOOLPY_FLASHSIZE="16MB"

# Partition
CONFIG_PARTITION_TABLE_SINGLE_APP_LARGE=y
CONFIG_PARTITION_TABLE_CUSTOM=n

# PSRAM — OPI mode for WT32-S3-WROVER-N16R8
CONFIG_SPIRAM=y
CONFIG_SPIRAM_MODE_OCT=y
CONFIG_SPIRAM_SPEED_80M=y
CONFIG_SPIRAM_FETCH_INSTRUCTIONS=y
CONFIG_SPIRAM_RODATA=y

# Performance
CONFIG_ESP_DEFAULT_CPU_FREQ_MHZ_240=y
CONFIG_FREERTOS_HZ=1000

# LVGL colour depth
CONFIG_LV_COLOR_DEPTH_16=y
```
